## meta-mender-toradex/conf/layer.conf
```bitbake
# We have a conf and classes directory, add to BBPATH
BBPATH .= ":${LAYERDIR}"

# We have recipes-* directories, add to BBFILES
BBFILES += "${LAYERDIR}/recipes-*/*/*.bb \
            ${LAYERDIR}/recipes-*/*/*.bbappend"

BBFILE_COLLECTIONS += "mender-toradex"
BBFILE_PATTERN_mender-toradex = "^${LAYERDIR}/"
BBFILE_PRIORITY_mender-toradex = "95"

LAYERDEPENDS_mender-toradex = "mender"
```
